## 67030260/Lab10-3_CoAP_Server/sdkconfig.defaults
```kconfig
CONFIG_MBEDTLS_SSL_PROTO_DTLS=y
CONFIG_MBEDTLS_SSL_COOKIE_C=y
CONFIG_ESP_BROWNOUT_DET=n
CONFIG_ESP32_BROWNOUT_DET=n
CONFIG_ESP_BROWNOUT_USE_INTR=n
```

## 67030298/Lab10-1_HTTP_REST_Server/sdkconfig.defaults
```kconfig
CONFIG_MDNS_PREDEF_NETIF_STA=y
CONFIG_MDNS_PREDEF_NETIF_AP=y
CONFIG_ESP_BROWNOUT_DET=n
```

## 67030298/Lab10-3_CoAP_Server/sdkconfig.defaults
```kconfig
CONFIG_MBEDTLS_SSL_PROTO_DTLS=y
CONFIG_MBEDTLS_SSL_COOKIE_C=y
CONFIG_ESP_BROWNOUT_DET=n
```

## Lab10-1_HTTP_REST_Server/main/Kconfig.projbuild
```kconfig
menu "Lab 10-1 Wi-Fi Configuration"

config LAB_WIFI_SSID
    string "Wi-Fi SSID (2.4 GHz)"
    default ""

config LAB_WIFI_PASSWORD
    string "Wi-Fi password (WPA2-Personal)"
    default ""

endmenu
```
